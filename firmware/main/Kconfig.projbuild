## firmware/main/Kconfig.projbuild
```kconfig
menu "APP Configuration"

    config PULSEMETER_RESTART_COUNT_RESET
        int "Restart count threshold for settings reset"
        range 3 10
        default 5
        help
            Erase NVS and restart once the persisted restart counter reaches
            this threshold.

    config PULSEMETER_WIFI_AP_SSID
        string "Provisioning Wi-Fi AP SSID"
        default "PulseMeter"
        help
            SSID used by the temporary SoftAP during Wi-Fi provisioning.

endmenu
```

## firmware/sdkconfig.defaults
```kconfig
CONFIG_ESPTOOLPY_FLASHSIZE_4MB=y
CONFIG_PARTITION_TABLE_CUSTOM=y
CONFIG_PARTITION_TABLE_CUSTOM_FILENAME="partitions_4mb_optimised.csv"

CONFIG_HTTPD_MAX_REQ_HDR_LEN=1024
CONFIG_SPIFFS_OBJ_NAME_LEN=64
CONFIG_FATFS_LFN_HEAP=y

# Application Rollback
CONFIG_BOOTLOADER_APP_ROLLBACK_ENABLE=y


CONFIG_IDF_TARGET="esp32c3"
CONFIG_FREERTOS_HZ=1000
CONFIG_ESPTOOLPY_FLASH_MODE_AUTO_DETECT=n
```
